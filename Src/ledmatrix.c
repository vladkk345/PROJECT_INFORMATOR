#include "stm32f4xx.h"
#include "ledmatrix.h"
#include "7219.h"
#include "font.h"
#include "scroll.h"

uint8_t ledmatrix_screenbuff[MAX7219_NUM * 8];

//==============================================================================
// Процедура заполняет буфер кадра значением FillValue
//==============================================================================
void ledmatrix_fill_screenbuff(uint8_t FillValue)
{
  for (uint16_t i = 0; i < (8 * MAX7219_NUM); i++)
    ledmatrix_screenbuff[i] = FillValue;
}
//==============================================================================


//==============================================================================
// Процедура сдвигает содержимое буфера кадра ВЛЕВО
// Самый правый столбец сохраняет при этом своё старое значение
//==============================================================================
void ledmatrix_ScrollLeft(void)
{
  for (uint16_t col = 1; col < (MAX7219_NUM * 8); col++)
    ledmatrix_screenbuff[col - 1] = ledmatrix_screenbuff[col];
}
//==============================================================================


//==============================================================================
// Процедура сдвигает содержимое буфера кадра ВПРАВО
// Самый левый столбец сохраняет при этом своё старое значение
//==============================================================================
void ledmatrix_ScrollRight(void)
{
  for (uint16_t col = (MAX7219_NUM * 8) - 1; col; col--)
    ledmatrix_screenbuff[col] = ledmatrix_screenbuff[col - 1];
}
//==============================================================================


//==============================================================================
// Процедура обновляет состояние индикаторов в соответствии с буфером кадра ledmatrix_screenbuff
//==============================================================================
void ledmatrix_update_from_buff(void)
{
  uint16_t max7219_SpiBuff[MAX7219_NUM];

  for (uint8_t Digit = 0; Digit < 8; Digit++)
  {
    for (uint8_t i = 0; i < MAX7219_NUM; i++)
    {
      // Формирование слова для записи в max7219[i] в строку Digit
      uint8_t Data = 0;
      for (uint8_t Col = 0; Col < 8; Col++)
      {
        uint8_t bit = (ledmatrix_screenbuff[(i << 3) + Col] & (1 << Digit)) ? 1 : 0;
        Data |= (bit << (7 - Col));
      }
      max7219_SpiBuff[i] = Data | ((uint16_t) (Digit + 1) << 8);
    }
    
    // Записываем одну строку во все max7219
    max7219_sendarray(max7219_SpiBuff);
  }
}
//==============================================================================

void init(void)
{
		Send_data(MAX7219_ALL_IDX, 0x0C,0x01);	// Выводим все max7219 из спящего режима
		Send_data(MAX7219_ALL_IDX, 0x0B,0x07);	// Устанавливаем кол-во символов (или строк), подключенных к max7219
		Send_data(MAX7219_ALL_IDX, 0x09,0x00);	// Устанавливаем режим перекодирования кодов цифр перед выводом на индикатор (для матриц =0)
		Send_data(MAX7219_ALL_IDX, 0x0A,0x00);	// Устанавливаем яркость индикаторов (от 0 до 15)
	
		// Очищаем ОЗУ микросхем max7219, потому что сейчас в них может быть мусор
		ledmatrix_fill_screenbuff(0);
		ledmatrix_update_from_buff();	
}